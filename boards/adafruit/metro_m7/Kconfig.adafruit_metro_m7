## boards/adafruit/metro_m7/Kconfig.adafruit_metro_m7
```kconfig
# Copyright (c) 2019, NXP
# Copyright (c) 2024, George White
# SPDX-License-Identifier: Apache-2.0

config BOARD_ADAFRUIT_METRO_M7
	select SOC_PART_NUMBER_MIMXRT1011DAE5A

config BUILD_OUTPUT_UF2_USE_FLASH_BASE
	default y if BUILD_OUTPUT_UF2

config BUILD_OUTPUT_UF2_USE_FLASH_OFFSET
	default y if BUILD_OUTPUT_UF2
```

## boards/adafruit/metro_m7/board.yml
```yaml
board:
  name: adafruit_metro_m7
  full_name: Adafruit Metro M7
  vendor: adafruit
  socs:
    - name: mimxrt1011
      variants:
      - name: sd
      - name: airlift
```

## boards/sparkfun/thing_plus_ra6m5/Kconfig.defconfig
```kconfig
# Copyright (c) 2025 George White
# Copyright 2025 Arduino SA
# SPDX-License-Identifier: Apache-2.0

if BOARD_SPARKFUN_THING_PLUS_RA6M5

config USE_DT_CODE_PARTITION
	default y

endif # BOARD_SPARKFUN_THING_PLUS_RA6M5
```

## boards/sparkfun/thing_plus_ra6m5/Kconfig.sparkfun_thing_plus_ra6m5
```kconfig
# Copyright (c) 2025 George White
# Copyright (c) 2025 Arduino SA
# SPDX-License-Identifier: Apache-2.0

config BOARD_SPARKFUN_THING_PLUS_RA6M5
	select SOC_R7FA6M5AH3CFP
```
